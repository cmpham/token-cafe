## firmware/ble/main/Kconfig.projbuild
```kconfig
menu "Token Cafe companion"
config TC_BOARD_JC4827W543
    bool "JC4827W543 NV3041A display and GT911 touch"
    default n
config TC_QA_USB
    bool "Local USB injection and framebuffer capture for QA"
    depends on TC_BOARD_JC4827W543
    default n
endmenu
```

## firmware/ble/sdkconfig.defaults
```kconfig
CONFIG_IDF_TARGET="esp32s3"
CONFIG_ESPTOOLPY_FLASHSIZE_16MB=y
CONFIG_SPIRAM=y
CONFIG_SPIRAM_MODE_OCT=y
CONFIG_SPIRAM_SPEED_80M=y
CONFIG_SPIRAM_USE_MALLOC=y
CONFIG_ESP_MAIN_TASK_STACK_SIZE=8192
CONFIG_LOG_DEFAULT_LEVEL_INFO=y
CONFIG_ESP_CONSOLE_UART_DEFAULT=y
CONFIG_BT_ENABLED=y
CONFIG_BT_NIMBLE_ENABLED=y
CONFIG_BT_NIMBLE_ROLE_CENTRAL=n
CONFIG_BT_NIMBLE_MAX_CONNECTIONS=1
CONFIG_BT_NIMBLE_ATT_PREFERRED_MTU=247
CONFIG_BT_NIMBLE_HOST_TASK_STACK_SIZE=8192
CONFIG_PARTITION_TABLE_SINGLE_APP_LARGE=y
```

## firmware/keypad/module/Kconfig
```kconfig
config TOKEN_CAFE_KEYPAD
    bool "Token Cafe keypad status display"
    default y
    depends on ZMK_DISPLAY && ZMK_BLE
```

## firmware/main/Kconfig.projbuild
```kconfig
menu "Token Cafe"
config TC_HEADLESS
    bool "Physical board bring-up without a display"
    default n
endmenu
```

## firmware/semantic/sdkconfig.defaults
```kconfig
CONFIG_IDF_TARGET="esp32s3"
CONFIG_ESPTOOLPY_FLASHSIZE_4MB=y
CONFIG_SPIRAM=y
CONFIG_SPIRAM_MODE_OCT=y
CONFIG_SPIRAM_SPEED_80M=y
CONFIG_SPIRAM_USE_MALLOC=y
CONFIG_ESP_MAIN_TASK_STACK_SIZE=32768
CONFIG_LOG_DEFAULT_LEVEL_INFO=y
CONFIG_ESP_CONSOLE_USB_SERIAL_JTAG=y
CONFIG_ESP_CONSOLE_SECONDARY_NONE=y
CONFIG_BT_ENABLED=y
CONFIG_BT_NIMBLE_ENABLED=y
CONFIG_BT_NIMBLE_ROLE_CENTRAL=n
CONFIG_BT_NIMBLE_MAX_CONNECTIONS=1
CONFIG_BT_NIMBLE_ATT_PREFERRED_MTU=247
CONFIG_BT_NIMBLE_HOST_TASK_STACK_SIZE=32768
CONFIG_PARTITION_TABLE_CUSTOM=y
CONFIG_PARTITION_TABLE_CUSTOM_FILENAME="partitions.csv"
CONFIG_TC_BOARD_JC4827W543=y
CONFIG_COMPILER_OPTIMIZATION_PERF=y
CONFIG_FREERTOS_HZ=1000
CONFIG_ESP_DEFAULT_CPU_FREQ_MHZ_240=y
CONFIG_ESP32S3_DATA_CACHE_64KB=y
CONFIG_ESP32S3_DATA_CACHE_LINE_64B=y
```
